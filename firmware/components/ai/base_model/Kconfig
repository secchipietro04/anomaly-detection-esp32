## firmware/components/ai/base_model/Kconfig
```kconfig
menu "AI Engine Configuration"

    config AI_ENABLE_DA
        bool "Enable Dense Autoencoder (DA)"
        default y
        select TFL_USE_FULLY_CONNECTED
        select TFL_USE_RELU
        select TFL_USE_SUB
        select TFL_USE_SQUARE
        select TFL_USE_MEAN
        help
            Enables operator registration for Dense Autoencoder (DA) model.

    config AI_ENABLE_VA
        bool "Enable Variational Autoencoder (VA)"
        default y
        select TFL_USE_FULLY_CONNECTED
        select TFL_USE_RELU
        select TFL_USE_EXP
        select TFL_USE_MUL
        select TFL_USE_ADD
        select TFL_USE_SUB
        select TFL_USE_SQUARE
        select TFL_USE_MEAN
        help
            Enables operator registration for Variational Autoencoder (VA) model.

    config AI_ENABLE_CA_1D
        bool "Enable Convolutional Autoencoder 1D (CA 1D)"
        default y
        select TFL_USE_CONV_2D
        select TFL_USE_TRANSPOSE_CONV
        select TFL_USE_MAX_POOL_2D
        select TFL_USE_RESHAPE
        select TFL_USE_RELU
        select TFL_USE_SUB
        select TFL_USE_SQUARE
        select TFL_USE_MEAN
        help
            Enables operator registration for 1D Convolutional Autoencoder model.

    config AI_ENABLE_CA_2D
        bool "Enable Convolutional Autoencoder 2D (CA 2D)"
        default y
        select TFL_USE_CONV_2D
        select TFL_USE_TRANSPOSE_CONV
        select TFL_USE_MAX_POOL_2D
        select TFL_USE_RESHAPE
        select TFL_USE_RELU
        select TFL_USE_SUB
        select TFL_USE_SQUARE
        select TFL_USE_MEAN
        help
            Enables operator registration for 2D Convolutional Autoencoder model.

    config AI_ENABLE_CLSTM
        bool "Enable Convolutional LSTM Autoencoder (CLSTM)"
        default y
        select TFL_USE_CONV_2D
        select TFL_USE_TRANSPOSE_CONV
        select TFL_USE_UNIDIRECTIONAL_SEQUENCE_LSTM
        select TFL_USE_RESHAPE
        select TFL_USE_FULLY_CONNECTED
        select TFL_USE_RELU
        select TFL_USE_TANH
        select TFL_USE_LOGISTIC
        select TFL_USE_MUL
        select TFL_USE_ADD
        select TFL_USE_SUB
        select TFL_USE_SQUARE
        select TFL_USE_MEAN
        help
            Enables operator registration for Convolutional LSTM Autoencoder (CLSTM) model.

    config AI_ENABLE_DENSE_R
        bool "Enable Fully Connected / Dense Router"
        default y
        select TFL_USE_FULLY_CONNECTED
        select TFL_USE_RELU
        select TFL_USE_SOFTMAX
        help
            Enables operator registration for Dense Router.

    config AI_ENABLE_STFTMCNN
        bool "Enable STFT + Micro-CNN Router"
        default y
        select TFL_USE_CONV_2D
        select TFL_USE_FULLY_CONNECTED
        select TFL_USE_RELU
        select TFL_USE_SOFTMAX
        select TFL_USE_MAX_POOL_2D
        help
            Enables operator registration for STFT + Micro-CNN Multi-branch Router.

    config AI_ENABLE_1D_CNN_R
        bool "Enable 1D CNN Router"
        default y
        select TFL_USE_CONV_2D
        select TFL_USE_MAX_POOL_2D
        select TFL_USE_FULLY_CONNECTED
        select TFL_USE_RELU
        select TFL_USE_SOFTMAX
        select TFL_USE_RESHAPE
        help
            Enables operator registration for 1D CNN Router.

    config AI_ENABLE_LSTM_MEM
        bool "Enable LSTM Memory Backbone"
        default y
        select TFL_USE_UNIDIRECTIONAL_SEQUENCE_LSTM
        select TFL_USE_FULLY_CONNECTED
        select TFL_USE_TANH
        select TFL_USE_LOGISTIC
        select TFL_USE_ADD
        select TFL_USE_MUL
        help
            Enables operator registration for LSTM Memory Backbone.

    # Hidden granular operator configs
    config TFL_USE_ABS
        bool
        default n

    config TFL_USE_ADD
        bool
        default n

    config TFL_USE_ADD_N
        bool
        default n

    config TFL_USE_ARG_MAX
        bool
        default n

    config TFL_USE_ARG_MIN
        bool
        default n

    config TFL_USE_ASSIGN_VARIABLE
        bool
        default n

    config TFL_USE_AVERAGE_POOL_2D
        bool
        default n

    config TFL_USE_BATCH_MATMUL
        bool
        default n

    config TFL_USE_BATCH_TO_SPACE_ND
        bool
        default n

    config TFL_USE_BROADCAST_ARGS
        bool
        default n

    config TFL_USE_BROADCAST_TO
        bool
        default n

    config TFL_USE_CALL_ONCE
        bool
        default n

    config TFL_USE_CAST
        bool
        default n

    config TFL_USE_CEIL
        bool
        default n

    config TFL_USE_CIRCULAR_BUFFER
        bool
        default n

    config TFL_USE_CONCATENATION
        bool
        default n

    config TFL_USE_CONV_2D
        bool
        default n

    config TFL_USE_COS
        bool
        default n

    config TFL_USE_CUMSUM
        bool
        default n

    config TFL_USE_DECODE
        bool
        default n

    config TFL_USE_DELAY
        bool
        default n

    config TFL_USE_DEPTH_TO_SPACE
        bool
        default n

    config TFL_USE_DEPTHWISE_CONV_2D
        bool
        default n

    config TFL_USE_DEQUANTIZE
        bool
        default n

    config TFL_USE_DETECTION_POSTPROCESS
        bool
        default n

    config TFL_USE_DIV
        bool
        default n

    config TFL_USE_DYNAMIC_UPDATE_SLICE
        bool
        default n

    config TFL_USE_EMBEDDING_LOOKUP
        bool
        default n

    config TFL_USE_ENERGY
        bool
        default n

    config TFL_USE_ELU
        bool
        default n

    config TFL_USE_EQUAL
        bool
        default n

    config TFL_USE_ETHOSU
        bool
        default n

    config TFL_USE_EXP
        bool
        default n

    config TFL_USE_EXPAND_DIMS
        bool
        default n

    config TFL_USE_FFT_AUTO_SCALE
        bool
        default n

    config TFL_USE_FILL
        bool
        default n

    config TFL_USE_FILTER_BANK
        bool
        default n

    config TFL_USE_FILTER_BANK_LOG
        bool
        default n

    config TFL_USE_FILTER_BANK_SQUARE_ROOT
        bool
        default n

    config TFL_USE_FILTER_BANK_SPECTRAL_SUBTRACTION
        bool
        default n

    config TFL_USE_FLOOR
        bool
        default n

    config TFL_USE_FLOOR_DIV
        bool
        default n

    config TFL_USE_FLOOR_MOD
        bool
        default n

    config TFL_USE_FRAMER
        bool
        default n

    config TFL_USE_FULLY_CONNECTED
        bool
        default n

    config TFL_USE_GATHER
        bool
        default n

    config TFL_USE_GATHER_ND
        bool
        default n

    config TFL_USE_GREATER
        bool
        default n

    config TFL_USE_GREATER_EQUAL
        bool
        default n

    config TFL_USE_HARD_SWISH
        bool
        default n

    config TFL_USE_IF
        bool
        default n

    config TFL_USE_IRFFT
        bool
        default n

    config TFL_USE_L2_NORMALIZATION
        bool
        default n

    config TFL_USE_L2_POOL_2D
        bool
        default n

    config TFL_USE_LEAKY_RELU
        bool
        default n

    config TFL_USE_LESS
        bool
        default n

    config TFL_USE_LESS_EQUAL
        bool
        default n

    config TFL_USE_LOG
        bool
        default n

    config TFL_USE_LOGICAL_AND
        bool
        default n

    config TFL_USE_LOGICAL_NOT
        bool
        default n

    config TFL_USE_LOGICAL_OR
        bool
        default n

    config TFL_USE_LOGISTIC
        bool
        default n

    config TFL_USE_LOG_SOFTMAX
        bool
        default n

    config TFL_USE_MAXIMUM
        bool
        default n

    config TFL_USE_MAX_POOL_2D
        bool
        default n

    config TFL_USE_MIRROR_PAD
        bool
        default n

    config TFL_USE_MEAN
        bool
        default n

    config TFL_USE_MINIMUM
        bool
        default n

    config TFL_USE_MUL
        bool
        default n

    config TFL_USE_NEG
        bool
        default n

    config TFL_USE_NOT_EQUAL
        bool
        default n

    config TFL_USE_OVERLAP_ADD
        bool
        default n

    config TFL_USE_PACK
        bool
        default n

    config TFL_USE_PAD
        bool
        default n

    config TFL_USE_PAD_V2
        bool
        default n

    config TFL_USE_PCAN
        bool
        default n

    config TFL_USE_PRELU
        bool
        default n

    config TFL_USE_QUANTIZE
        bool
        default n

    config TFL_USE_READ_VARIABLE
        bool
        default n

    config TFL_USE_REDUCE_ALL
        bool
        default n

    config TFL_USE_REDUCE_MAX
        bool
        default n

    config TFL_USE_REDUCE_MIN
        bool
        default n

    config TFL_USE_RELU
        bool
        default n

    config TFL_USE_RELU6
        bool
        default n

    config TFL_USE_RESHAPE
        bool
        default n

    config TFL_USE_RESIZE_BILINEAR
        bool
        default n

    config TFL_USE_RESIZE_NEAREST_NEIGHBOR
        bool
        default n

    config TFL_USE_REVERSE_V2
        bool
        default n

    config TFL_USE_RFFT
        bool
        default n

    config TFL_USE_ROUND
        bool
        default n

    config TFL_USE_RSQRT
        bool
        default n

    config TFL_USE_SELECT_V2
        bool
        default n

    config TFL_USE_SHAPE
        bool
        default n

    config TFL_USE_SIN
        bool
        default n

    config TFL_USE_SLICE
        bool
        default n

    config TFL_USE_SOFTMAX
        bool
        default n

    config TFL_USE_SPACE_TO_BATCH_ND
        bool
        default n

    config TFL_USE_SPACE_TO_DEPTH
        bool
        default n

    config TFL_USE_SPLIT
        bool
        default n

    config TFL_USE_SPLIT_V
        bool
        default n

    config TFL_USE_SQUEEZE
        bool
        default n

    config TFL_USE_SQRT
        bool
        default n

    config TFL_USE_SQUARE
        bool
        default n

    config TFL_USE_SQUARED_DIFFERENCE
        bool
        default n

    config TFL_USE_STRIDED_SLICE
        bool
        default n

    config TFL_USE_STACKER
        bool
        default n

    config TFL_USE_SUB
        bool
        default n

    config TFL_USE_SUM
        bool
        default n

    config TFL_USE_SVDF
        bool
        default n

    config TFL_USE_TANH
        bool
        default n

    config TFL_USE_TRANSPOSE_CONV
        bool
        default n

    config TFL_USE_TRANSPOSE
        bool
        default n

    config TFL_USE_UNPACK
        bool
        default n

    config TFL_USE_UNIDIRECTIONAL_SEQUENCE_LSTM
        bool
        default n

    config TFL_USE_VAR_HANDLE
        bool
        default n

    config TFL_USE_WHILE
        bool
        default n

    config TFL_USE_WINDOW
        bool
        default n

    config TFL_USE_ZEROS_LIKE
        bool
        default n

endmenu
```

## firmware/components/ai/model_arch_ca/Kconfig
```kconfig
menu "Model Architecture CA"
    config MODEL_ARCH_CA_ENABLED
        bool "Enable Convolutional Autoencoder (CA)"
        default y
        help
            Enable the Convolutional Autoencoder (CA) model component.
endmenu
```

## firmware/components/ai/model_arch_clstm/Kconfig
```kconfig
menu "Model Architecture CLSTM"
    config MODEL_ARCH_CLSTM_ENABLED
        bool "Enable Convolutional LSTM Autoencoder (CLSTM)"
        default y
        help
            Enable the Convolutional LSTM Autoencoder (CLSTM) model component.
endmenu
```

## firmware/components/ai/model_arch_dense/Kconfig
```kconfig
menu "Model Architecture Dense (DA & Dense Router)"
    config MODEL_ARCH_DENSE_ENABLED
        bool "Enable Dense Model (DA & Dense Router)"
        default y
        help
            Enable the Dense Model component (merged Dense Autoencoder and Dense Router).
endmenu
```

## firmware/components/ai/model_arch_fits/Kconfig
```kconfig
menu "Model Architecture FITS"
    config MODEL_ARCH_FITS_ENABLED
        bool "Enable FITS Model in ft mode"
        default y
        help
            Enable the FITS (Frequency Interpolation for Time Series) model component.
endmenu
```

## firmware/components/ai/model_arch_generic/Kconfig
```kconfig
menu "Generic Model Configuration"
    config MODEL_ARCH_GENERIC_ENABLED
        bool "Enable Generic Model Wrapper"
        default y
        help
            Enable the generic TFLite model wrapper component to load arbitrary Keras models.
endmenu
```

## firmware/components/ai/model_arch_mr/Kconfig
```kconfig
menu "Model Architecture MiniRocket (MR)"
    config MODEL_ARCH_MR_ENABLED
        bool "Enable MiniRocket Model (MR)"
        default y
        help
            Enable the MiniRocket (MR) Model component, providing custom optimized C inference.
endmenu
```

## firmware/components/ai/model_arch_stftmcnn/Kconfig
```kconfig
menu "Model Architecture STFT + Micro-CNN"
    config MODEL_ARCH_STFTMCNN_ENABLED
        bool "Enable STFT + Micro-CNN Model"
        default y
        help
            Enable the STFT (Short-Time Fourier Transform) + Micro-CNN Model component.
endmenu
```

## firmware/components/ai/model_arch_tn/Kconfig
```kconfig
menu "Model Architecture TN"
    config MODEL_ARCH_TN_ENABLED
        bool "Enable TimesNet (TN)"
        default y
        help
            Enable the TimesNet (TN) model component.
endmenu
```

## firmware/components/ai/model_arch_va/Kconfig
```kconfig
menu "Model Architecture VA"
    config MODEL_ARCH_VA_ENABLED
        bool "Enable Variational Autoencoder (VA)"
        default y
        help
            Enable the Variational Autoencoder (VA) model component.
endmenu
```

## firmware/components/esp_fft_wrapper/Kconfig
```kconfig
menu "ESP FFT Wrapper Configuration"
    config ESP_FFT_WRAPPER_ENABLED
        bool "Enable ESP FFT Wrapper"
        default y
        help
            Enable the ESP-DSP optimized FFT wrapper component.

    config ESP_FFT_MAX_SIZE
        int "Maximum FFT size"
        default 1024
        range 32 4096
        help
            Set the maximum FFT window size supported by the wrapper tables.
endmenu
```

## firmware/components/model_ensemble/Kconfig
```kconfig
menu "Model Ensemble Configuration"
    config MODEL_ENSEMBLE_ENABLED
        bool "Enable Model Ensemble"
        default y
        help
            Enable the Model Ensemble component that integrates routing and submodel execution.

    config RECORD_INFERENCE_TIME
        bool "Record and Telemetry Inference Execution Time"
        default y
        help
            Measure inference execution time in ms and send it in the InferencePacket CBOR payload.
endmenu
```
